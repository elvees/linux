// SPDX-License-Identifier: GPL-2.0+
/*
 * Copyright 2021 RnD Center "ELVEES", JSC
 */

/dts-v1/;

#include <dt-bindings/gpio/gpio.h>
#include <dt-bindings/input/input.h>

#include "mcom03-ecam03-common.dtsi"

/ {
	model = "ECAM03DM r1.0";
	compatible = "elvees,ecam03dm-r1.0",
		     "elvees,ecam03dm",
		     "elvees,mcom03";

	/delete-node/ sdr@1900000;
};
