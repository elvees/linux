// SPDX-License-Identifier: GPL-2.0+
/*
 * Copyright 2023 RnD Center "ELVEES", JSC
 */

/dts-v1/;

#include "mcom03-pm03cam-r2.0-ecam03common-r2.0.dts"

/ {
	model = "ECAM03DM r2.0";
	compatible = "elvees,pm03cam-r2.0-ecam03dm-r2.0",
		     "elvees,pm03cam-r2.0-ecam03common-r2.0",
		     "elvees,pm03cam-r2.0",
		     "elvees,mcom03";
};

&qmi8658c {
	mount-matrix = "1", "0", "0",
		       "0", "1", "0",
		       "0", "0", "1";
};

&uart3 {
	status = "disabled";
};
