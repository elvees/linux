// SPDX-License-Identifier: GPL-2.0+
/*
 * Copyright 2023 RnD Center "ELVEES", JSC
 */

/dts-v1/;

#include "mcom03-elvmc03smarc-r1.0-elvsmarccb-r2.10.3.dts"

/ {
	model = "ELV-MC03-SMARC r1.0, ELV-SMARC-CB r3.1.0";
	compatible = "elvees,elvmc03smarc-r1.0-elvsmarccb-r3.1.0",
		     "elvees,elvmc03smarc-elvsmarccb",
		     "elvees,elvsmarccb-r3.1.0",
		     "elvees,elvsmarccb",
		     "elvees,elvmc03smarc-r1.0",
		     "elvees,elvmc03smarc",
		     "elvees,mcom03";
};

&sdhci1 {
	/delete-property/ disable-wp;
};

&flash1 {
	compatible = "winbond,w25q128fw", "jedec,spi-nor";
};
