// SPDX-License-Identifier: GPL-2.0+
/*
 * Copyright 2023 RnD Center "ELVEES", JSC
 */

/dts-v1/;

#include "mcom03-pm03cam-r2.0-ecam03common-r2.0.dts"

/ {
	model = "ECAM03BX r2.0";
	compatible = "elvees,pm03cam-r2.0-ecam03bx-r2.0",
		     "elvees,pm03cam-r2.0-ecam03common-r2.0",
		     "elvees,pm03cam-r2.0",
		     "elvees,mcom03";

	gpio-leds {
		compatible = "gpio-leds";

		green {
			gpios = <&mfbsp1_gpio 8 GPIO_ACTIVE_LOW>;
			default-state = "off";
		};

		red {
			gpios = <&mfbsp1_gpio 9 GPIO_ACTIVE_LOW>;
			default-state = "off";
		};
	};
};

&gpio0a {
	gpio-line-names = "", "OPEN_CLOSE_BUTTON", "ALARM_IN1", "ALARM_IN2",
		"", "", "", "";
};

&gpio0c {
	gpio-line-names = "P_Iris_A", "P_Iris_B", "P_Iris_nA", "CMOS_nRST",
		"P_Iris_nB", "", "", "";
};

&gpio0d {
	gpio-line-names = "IR_nA", "IR_A", "", "", "", "", "", "";
};

&gpio1a {
	gpio-line-names = "", "", "", "",
		"", "", "", "ALARM_OUT";
};

&mfbsp1_gpio {
	status = "okay";

	gpio-line-names = "", "", "", "", "", "", "", "", "GPIO_LEDG", "GPIO_LEDR";
	gpio-reserved-ranges = <0 8>;

&qmi8658c {
	mount-matrix = "1", "0", "0",
		       "0", "1", "0",
		       "0", "0", "-1";
};
