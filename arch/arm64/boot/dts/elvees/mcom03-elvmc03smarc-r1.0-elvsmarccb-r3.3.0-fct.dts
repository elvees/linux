// SPDX-License-Identifier: GPL-2.0+
// Copyright 2024 RnD Center "ELVEES", JSC

/dts-v1/;

#include "mcom03-elvmc03smarc-r1.0-elvsmarccb-r3.3.0.dts"

/ {
	compatible = "elvees,elvmc03smarc-r1.0-elvsmarccb-r3.3.0-fct",
		     "elvees,elvmc03smarc-r1.0-elvsmarccb-r3.3.0",
		     "elvees,elvmc03smarc-elvsmarccb",
		     "elvees,elvsmarccb-r3.3.0",
		     "elvees,elvsmarccb",
		     "elvees,elvmc03smarc-r1.0",
		     "elvees,elvmc03smarc",
		     "elvees,mcom03";
};

&i2c_lcd {
	eeprom@50 {
		compatible = "microchip,24c32", "atmel,24c32";
		reg = <0x50>;
	};
};
