// SPDX-License-Identifier: GPL-2.0+
// Copyright 2025 RnD Center "ELVEES", JSC

/dts-v1/;

#include "mcom03r-ip-ku-m1-r1.0.dts"

/ {
	compatible = "elvees,mcom03r-ipku-m1-r1.0-pm",
		     "elvees,mcom03r-ipku-m1-r1.0",
		     "elvees,mcom03r-ipku-m1",
		     "elvees,mcom03r";
};

/* Disable PCIe because it doesn't support runtime PM and can not be unbound or
 * unloaded.
 */
&pcie0 {
	status = "disabled";
};

&pcie1 {
	status = "disabled";
};
