## Documentation/devicetree/bindings/clock/elvees,mcom03-clk-pm.yaml
```yaml
# SPDX-License-Identifier: (GPL-2.0-only OR BSD-2-Clause)
%YAML 1.2
---
$id: http://devicetree.org/schemas/clock/elvees,mcom03-clk-pm.yaml#
$schema: http://devicetree.org/meta-schemas/core.yaml#

title: MCom-03 subsystem clock and power management

maintainers:
  - Vasiliy Zasukhin <vzasukhin@elvees.com>

properties:
  compatible:
    enum:
      - elvees,mcom03-clk-pm

  clocks: true

  '#clock-cells':
    const: 1

  assigned-clocks: true

  assigned-clock-rates: true

  assigned-clock-parents: true

  elvees,power-domain:
    type: boolean
    description: |
      If this property exist then power management is available for the subsystem.

  '#power-domain-cells':
    const: 0

  elvees,service-urb:
    $ref: /schemas/types.yaml#/definitions/phandle
    description: |
      Reference to URB node of SERVICE subsystem, must be set if "elvees,power-domain" exist.

  reg:
    description: |
      Array of regions which define subsystem UCG memory regions.

  elvees,subsystem:
    $ref: /schemas/types.yaml#/definitions/uint32
    minimum: 0
    maximum: 7
    description: |
      MCom-03 SoC subsystem. Can be used defines MCOM03_SUBSYSTEM_* from
      include/dt-bindings/soc/elvees,mcom03.h file.

  elvees,urb:
    $ref: /schemas/types.yaml#/definitions/phandle
    description: |
      Reference to current subsystem URB node.

  enabled-clocks:
    description: |
      List of clocks that must be enabled by clock and power management driver.

allOf:
  - if:
      properties:
        elvees,subsystem:
          const: 3  # MCOM03_SUBSYSTEM_HSPERIPH
    then:
      properties:
        clocks:
          items:
            - description: input clock from XTI
            - description: CLK125 input clock
    else:
      if:
        properties:
          elvees,subsystem:
            const: 5  # MCOM03_SUBSYSTEM_LSPERIPH1
      then:
        properties:
          clocks:
            items:
              - description: input clock from XTI
              - description: I2S0_SCLK_IN input clock
      else:
        properties:
          clocks:
            maxItems: 1
            description: input clock from XTI

required:
  - compatible
  - reg
  - clocks
  - '#clock-cells'
  - elvees,subsystem
  - elvees,urb

additionalProperties: false

examples:
  - |
    #include <dt-bindings/clock/mcom03-clock.h>
    #include <dt-bindings/interrupt-controller/arm-gic.h>
    #include <dt-bindings/soc/elvees,mcom03.h>

    hsperiph_clk125: hsperiph_clk125 {
        #clock-cells = <0>;
        compatible = "fixed-clock";
        clock-frequency = <125000000>;
    };

    hsperiph_clocks: clock-controller@10410000 {
        compatible = "elvees,mcom03-clk-pm";
        #clock-cells = <1>;
        elvees,subsystem = <MCOM03_SUBSYSTEM_HSPERIPH>;
        clocks = <&xti_clk>, <&hsperiph_clk125>;
        elvees,urb = <&hsperiph_urb>;
        reg = <0 0x10410000 0 0x80>, <0 0x10420000 0 0x80>, // UCG0, UCG1
              <0 0x10430000 0 0x80>, <0 0x10440000 0 0x80>; // UCG2, UCG3

        /* After SoC reset REFMUX2 and REFMUX3 uses CLK125 as parent
         * clock. But most boards do not have a signal on CLK125 pad.
         * To switch REFMUX source to PLL we need to specify
         * assigned-clocks/assigned-clock-parents properties. Because
         * assigned-clocks is already exists to setup rates, we also add
         * REFMUXes records to assigned-clocks and assigned-clock-rates.
         * In assigned-clock-rates for REFMUXes set zero to ignore
         * this record for setting rate.
         * To switch parent back to CLK125 assigned-clocks and
         * assigned-clock-parents properties can be used in another
         * nodes.
         * For example, if Ethernet controllers require 125 MHz on
         * UCG2 from CLK125 pad then add to emac0 and emac1 nodes:
         *   assigned-clocks = <&clock CLK_HSP_REFMUX2>;
         *   assigned-clock-parents = <&hsperiph_clk125>;
         */
        assigned-clocks = <&hsperiph_clocks CLK_HSP_REFMUX0>,
                          <&hsperiph_clocks CLK_HSP_REFMUX1>,
                          <&hsperiph_clocks CLK_HSP_REFMUX2>,
                          <&hsperiph_clocks CLK_HSP_REFMUX3>,
                          <&hsperiph_clocks CLK_HSP_PLL0>,
                          <&hsperiph_clocks CLK_HSP_UCG0_SYS>,
                          <&hsperiph_clocks CLK_HSP_UCG0_DMA>,
                          <&hsperiph_clocks CLK_HSP_UCG0_CTR>,
                          <&hsperiph_clocks CLK_HSP_UCG0_SPRAM>,
                          <&hsperiph_clocks CLK_HSP_UCG0_EMAC0>,
                          <&hsperiph_clocks CLK_HSP_UCG0_EMAC1>,
                          <&hsperiph_clocks CLK_HSP_UCG0_USB0>,
                          <&hsperiph_clocks CLK_HSP_UCG0_USB1>,
                          <&hsperiph_clocks CLK_HSP_UCG0_NFC>,
                          <&hsperiph_clocks CLK_HSP_UCG0_PDMA2>,
                          <&hsperiph_clocks CLK_HSP_UCG0_SDMMC0>,
                          <&hsperiph_clocks CLK_HSP_UCG0_SDMMC1>,
                          <&hsperiph_clocks CLK_HSP_UCG0_QSPI>,
                          <&hsperiph_clocks CLK_HSP_UCG1_SDMMC0_XIN>,
                          <&hsperiph_clocks CLK_HSP_UCG1_SDMMC1_XIN>,
                          <&hsperiph_clocks CLK_HSP_UCG1_NFC_FLASH>,
                          <&hsperiph_clocks CLK_HSP_UCG2_EMAC0_1588>,
                          <&hsperiph_clocks CLK_HSP_UCG2_EMAC1_1588>,
                          <&hsperiph_clocks CLK_HSP_UCG3_USB0_SUSPEND>,
                          <&hsperiph_clocks CLK_HSP_UCG3_USB1_SUSPEND>;
        assigned-clock-parents = <&hsperiph_clocks CLK_HSP_PLL0>,
                                 <&hsperiph_clocks CLK_HSP_PLL0>,
                                 <&hsperiph_clocks CLK_HSP_PLL0>,
                                 <&hsperiph_clocks CLK_HSP_PLL0>;
        assigned-clock-rates = <0
                                0
                                0
                                0
                                1125000000
                                225000000
                                225000000
                                93750000
                                225000000
                                125000000
                                125000000
                                125000000
                                125000000
                                125000000
                                225000000
                                93750000
                                93750000
                                93750000
                                125000000
                                93750000
                                93750000
                                125000000
                                125000000
                                25000000
                                25000000>;
        enabled-clocks = <CLK_HSP_UCG0_SYS
                          CLK_HSP_UCG0_DMA
                          CLK_HSP_UCG0_CTR>;
    };

    sdr_clocks: sdr_clocks@1900000 {
        compatible = "elvees,mcom03-clk-pm";
        elvees,subsystem = <MCOM03_SUBSYSTEM_SDR>;
        clocks = <&xti_clk>;
        elvees,urb = <&sdr_urb>;
        reg = <0 0x1900000 0 0x80>;
        #clock-cells = <1>;
        assigned-clocks = <&sdr_clocks CLK_SDR_PLL0>,
                          <&sdr_clocks CLK_SDR_PLL1>,
                          <&sdr_clocks CLK_SDR_PLL2>,
                          <&sdr_clocks CLK_SDR_UCG0_CFG>,
                          <&sdr_clocks CLK_SDR_UCG0_EXT>;
        assigned-clock-rates = <1200000000
                                648000000
                                459000000
                                100000000
                                600000000>;
        enabled-clocks = <CLK_SDR_UCG0_CFG>,
                         <CLK_SDR_UCG0_AUX_PCI>;
        #power-domain-cells = <0>;
        elvees,power-domain;
        elvees,service-urb = <&service_urb>;
    };

    /* If Ethernet requires external CLK125 clock then specify parrent for
     * REFMUX2 in EMAC node
     */
    emac0: ethernet@10200000 {
        compatible = "arasan,gemac";
        #address-cells = <1>;
        #size-cells = <0>;
        reg = <0x10200000 0x1000>;
        clocks = <&hsperiph_clocks CLK_HSP_UCG0_EMAC0>,
                 <&hsperiph_clocks CLK_HSP_UCG2_EMAC0_RGMII_TXC>,
                 <&hsperiph_clocks CLK_HSP_UCG2_EMAC0_1588>;
        clock-names = "busclk", "txc", "clk_1588";
        interrupts = <GIC_SPI 39 IRQ_TYPE_LEVEL_HIGH>;
        resets = <&hsperiph_reset HSPERIPH_RST_EMAC0>;
        arasan,desc-pool = <&emac_desc_pool>;
        phy-mode = "rgmii-id";
        phy-handle = <&ethernet_phy0>;
        arasan,axi-bus-width64;
        pinctrl-names = "default";
        pinctrl-0 = <&emac0_default>;
        assigned-clocks = <&hsperiph_clocks CLK_HSP_REFMUX2>;
        assigned-clock-parents = <&hsperiph_clk125>;
    };

...
```

## Documentation/devicetree/bindings/misc/heater-gpio.yaml
```yaml
# SPDX-License-Identifier: GPL-2.0-only OR BSD-2-Clause
%YAML 1.2
---
$id: http://devicetree.org/schemas/misc/heater-gpio.yaml#
$schema: http://devicetree.org/meta-schemas/core.yaml#

title: Heater controlled via GPIO lines

maintainers:
  - Oleg Ivanov <oaivanov@elvees.com>

properties:
  compatible:
    enum:
      - heater-gpio

  gpios:
    maxItems: 1
    description: GPIO used to control heater.

required:
  - compatible

additionalProperties: false

examples:
  - |
    #include <dt-bindings/gpio/gpio.h>
    heater-gpio {
      compatible = "heater-gpio";
      gpios = <&gpio1d 4 GPIO_ACTIVE_HIGH>;
    };
```

## Documentation/devicetree/bindings/pci/elvees,mcom03-pcie-ep.yaml
```yaml
# SPDX-License-Identifier: (GPL-2.0-only OR BSD-2-Clause)
%YAML 1.2
---
$id: http://devicetree.org/schemas/pci/elvees,mcom03-pcie-ep.yaml#
$schema: http://devicetree.org/meta-schemas/core.yaml#

title: ELVEES MCom-03 PCIe Endpoint controller

maintainers:
  - Ilya Popov <ipopov@elvees.com>

description: |+
  ELVEES MCom-03 PCIe controller is based on the Synopsys DesignWare PCIe
  dual mode controller IP. This is the Endpoint part and thus inherits common
  properties defined in snps,dw-pcie-ep.yaml.

allOf:
  - $ref: /schemas/pci/snps,dw-pcie-ep.yaml#

properties:
  compatible:
    const: elvees,mcom03-pcie-ep

  reg:
    items:
      - description: Data Bus Interface (DBI) registers.
      - description: Data Bus Interface 2 (DBI2) for accessing shadow registers.
      - description: iATU memory IO region.
      - description: ELVEES specific application registers.
      - description:
          Outbound iATU-capable memory-region which will be used to
          generate various application-specific traffic on the PCIe bus
          hierarchy.

  reg-names:
    items:
      - const: dbi
      - const: dbi2
      - const: atu
      - const: apb
      - const: addr_space

  resets:
    description: Should contain platform-specific resets (see the example)

  clocks:
    items:
      - description: Controller Primary clock.
      - description: Auxiliary clock for the controller PMC domain.

  clock-names:
    items:
      - const: core
      - const: aux

required:
  - compatible
  - reg
  - reg-names
  - num-lanes
  - resets
  - clocks
  - clock-names

unevaluatedProperties: false

examples:
  - |
    #include <dt-bindings/clock/mcom03-clock.h>
    #include <dt-bindings/soc/elvees,mcom03.h>

    mcom03-pcie-bus {
      #address-cells = <2>;
      #size-cells = <2>;

      pcie0_ep: pcie-ep@2000000 {
        compatible = "elvees,mcom03-pcie-ep";
        reg = <0x0 0x2000000 0x0 0x100000>,
              <0x0 0x2100000 0x0 0x100000>,
              <0x0 0x2300000 0x0 0x80000>,
              <0x0 0x1a00000 0x0 0x800>,
              <0x0 0x60000000 0x0 0x10000000>;
        reg-names = "dbi", "dbi2", "atu", "apb", "addr_space";
        num-lanes = <4>;
        resets = <&sdr_reset SDR_RST_PCI_ICT>,
                 <&sdr_reset SDR_RST_PCI0_BTN>;
        clocks = <&sdr_clocks CLK_SDR_GATE_PCIE0>,
                 <&sdr_clocks CLK_SDR_UCG0_AUX_PCI>;
        clock-names = "core", "aux";
      };
    };
```
