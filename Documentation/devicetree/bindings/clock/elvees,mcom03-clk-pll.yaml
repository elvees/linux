## Documentation/devicetree/bindings/leds/ti,tps6105x-flash.yaml
```yaml
# SPDX-License-Identifier: (GPL-2.0-only OR BSD-2-Clause)
%YAML 1.2
---
$id: http://devicetree.org/schemas/leds/ti,tps6105x-flash.yaml#
$schema: http://devicetree.org/meta-schemas/core.yaml#

title: Device tree bindings for TI TPS61050/61052 Boost Converters FLASH mode

maintainers:
  - Ilya Popov <ipopov@elvees.com>

description: |
  This is a part of devicetree bindings for the TP61050/TPS61052 high-power
  "white LED driver". This bindngs describes "flash" function of MFD, for
  description of other functions please read ../mfd/tps6105x.txt.

properties:
  compatible:
    oneOf:
      - items:
        - emum: ti,tps61050
        - emum: ti,tps61052

  reg:
    const: 0x33

  flash:
    type: object
    $ref: common.yaml#
    description: Properties for the FLASH.
    properties:
      compatible:
        const: ti,tps6105x-flash

      label:
        description: |
          The label for this flash-led. If omitted, the label is taken from
          the node name.

      flash-max-timeout-us:
        description: |
          Flash LED maximum timeout.
          Valid values: 32800 - 1016800, step by 32800.
        minimum: 0
        maximum: 1016800
        default: 557600

      led-max-microamp:
        maximum: 500000
        description: |
          Maximum torch current
          Valid values: 0, 50000, 75000, 100000, 150000, 200000, 250000,
          400000, 500000 (rounded down).

      flash-max-microamp:
        maximum: 1200000
        minimum: 150000
        default: 500000
        description: |
          Flash LED maximum current
          Valid values: 150000, 200000, 300000, 400000, 500000, 700000,
          900000, 1200000 (rounded down).

      ti,edge-sensitive:
        description: |
          This property enables edge-sensitive mode for flash timer,
          if not present level-sensitive mode is used.

    required:
      - compatible
      - flash-max-microamp
      - flash-max-timeout-us
      - led-max-microamp

    additionalProperties: false


required:
  - compatible
  - reg
  - flash

additionalProperties: false

examples:
  - |
    tps61050: flash@33 {
      compatible = "ti,tps61050";
      reg = <0x33>;

      flash {
        compatible = "ti,tps6105x-flash";
        edge-sensitive;
        label = "flash-led";
        led-max-microamp = <500000>;
        flash-max-microamp = <900000>;
        flash-max-timeout-us = <500000>;
      };
    };
...
```

## Documentation/devicetree/bindings/media/i2c/tc358748.txt
```
* Toshiba TC358748 parallel video to MIPI CSI2 bridge

Required Properties:
- compatible: Must be "toshiba,tc358748".
- reg: I2C slave address.
- clock-frequency: input clock oscillator.
- pixel-frequency: input pixel clock.
- vvalid-invert: active VValid signal is low if property is set.
- hvalid-invert: active HValid signal is low if property is set.

For further reading on port node refer to
Documentation/devicetree/bindings/media/video-interfaces.txt.

Example:

	i2c0@1c22000 {
		...
		...
		tc358748@0e {
			compatible = "toshiba,tc358748";
			reg = <0x0e>;
			clock-frequency = <40000000>;
			pixel-frequency = <126000000>;
			vvalid-invert;
			port {
				tc358748endpoint: endpoint {
					remote = <&vinc_endpoint0>;
				};
			};
		};
		...
	};
```

## Documentation/devicetree/bindings/net/arasan,gemac.yaml
```yaml
# SPDX-License-Identifier: GPL-2.0-only OR BSD-2-Clause
%YAML 1.2
---
$id: http://devicetree.org/schemas/net/arasan,gemac.yaml#
$schema: http://devicetree.org/meta-schemas/core.yaml#

title: Arasan GEMAC Ethernet controller

maintainers:
  - Dmitriy Zagrebin <dzagrebin@elvees.com>

description: Bindings for the Arasan GEMAC Ethernet controller.

properties:
  compatible:
    const: arasan,gemac

  '#address-cells':
    const: 1

  '#size-cells':
    const: 0

  reg:
    items:
      - description: Register set

  clocks:
    description:
      Must reference the clocks supplied on AXI clock and RGMII TXC.
      Optionally could refererence the PTP timer clock. PTP timer clock must be set to 125 MHz.
    minItems: 2
    maxItems: 3

  clock-names:
    description:
      Must contains at least two strings. 'busclk' for the clock supplied on AXI clock
      and 'txc' for the RGMII TXC. Optionally could contain 'clk_1588' string for the
      PTP timer clock.
    oneOf:
      - items:
          - const: busclk
          - const: txc
      - items:
          - const: busclk
          - const: txc
          - const: clk_1588

  interrupts:
    items:
      - description: interrupt line on the AHB/AXI Interface

  resets:
    maxItems: 1

  arasan,desc-pool:
    description: |
      Phandle to the device SRAM. It is required for the Arasan GEMAC controllers rel2.20
      to workaround a hardware bug.
    $ref: /schemas/types.yaml#/definitions/phandle-array

  arasan,axi-bus-width64:
    description:
      Set this property if you want to use 64-bit data transfers to increase DMAC perfomance.
    type: boolean

  arasan,hwfifo_size:
    description:
      Size of hardware FIFOs for Rx and Tx frames in bytes.
    $ref: /schemas/types.yaml#/definitions/uint32

  arasan,max-mdc-freq:
    description: |
      Maximum value of MDC frequency. It is used to adjust the ratio between the MDC clock and
      the Host clock (AHB or AXI clock).
      Default value set by driver to 2.5 MHz.
    $ref: /schemas/types.yaml#/definitions/uint32

  arasan,tx-start-threshold:
    description: |
      Threshold size of packet in bytes before the packet is sent.
      Default value depends on Ethernet speed according to User's Manual.
    $ref: /schemas/types.yaml#/definitions/uint32

  phy-mode: true

  phy-handle: true

required:
  - compatible
  - '#address-cells'
  - '#size-cells'
  - reg
  - clocks
  - clock-names
  - interrupts
  - phy-mode
  - phy-handle

additionalProperties: false

examples:
  - |
    #include <dt-bindings/interrupt-controller/arm-gic.h>
    #include <dt-bindings/soc/elvees,mcom03.h>
    #include <dt-bindings/clock/mcom03-clock.h>
    #include <dt-bindings/gpio/gpio.h>

    spram: spram@0 {
      compatible = "mmio-sram";
      #address-cells = <1>;
      #size-cells = <1>;
      reg = <0 0x10000>;
      clocks = <&hsperiph_clocks CLK_HSP_UCG0_SPRAM>;

      emac_desc_pool: sram-pool@0 {
        reg = <0 0x2000>;
        pool;
      };
    };

    ethernet@10200000 {
      compatible = "arasan,gemac";
      #address-cells = <1>;
      #size-cells = <0>;
      reg = <0x10200000 0x1000>;
      clocks = <&hsperiph_ucg0 CLK_HSP_UCG0_EMAC0>,
               <&hsperiph_ucg2 CLK_HSP_UCG2_EMAC0_RGMII_TXC>,
               <&hsperiph_ucg2 CLK_HSP_UCG2_EMAC0_1588>;
      clock-names = "busclk", "txc", "clk_1588";
      interrupts = <GIC_SPI 39 IRQ_TYPE_LEVEL_HIGH>;
      resets = <&hsperiph_reset HSPERIPH_RST_EMAC0>;
      arasan,desc-pool = <&emac_desc_pool>;
      arasan,axi-bus-width64;
      phy-mode = "rgmii-id";
      phy-handle = <&ethernet_phy0>;
    };
```

## Documentation/devicetree/bindings/net/can/elvees,mcom03-mfbsp-can.yaml
```yaml
# SPDX-License-Identifier: GPL-2.0
%YAML 1.2
---
$id: http://devicetree.org/schemas/net/can/elvees,mcom03-mfbsp-can.yaml#
$schema: http://devicetree.org/meta-schemas/core.yaml#

title: ELVEES MCom-03 MFBSP CAN controller

maintainers:
  - Ilya Orazov <iorazov@elvees.com>

description: Bindings for the ELVEES MCom-03 MFBSP CAN controller.

properties:
  compatible:
    const: elvees,mfbsp-can

  reg:
    items:
      - description: MFBSP CAN registers
      - description: filters and elements of CAN controller
      - description: config registers of CAN controller

  reg-names:
    items:
      - const: can
      - const: filters_and_elements
      - const: cfg

  interrupt-parent:
    items:
      - description: specifies the phandle to the parent interrupt controller

  interrupts:
    items:
      - description: interrupt line0
    minItems: 1
    maxItems: 1

  clocks:
    items:
      - description: service subsystem clock

  elvees,mram-cfg:
    description: |
      Message RAM configuration data.
      Multiple MFBSP CAN instances can share the same Message RAM
      and each element(e.g Rx FIFO or Tx Buff and etc) number
      in Message RAM is also configurable, so this property is
      telling driver how the shared or private Message RAM are
      used by this MFBSP CAN controller.

      The format should be as follows:
      <offset sidf_elems xidf_elems rxf0_elems txb_elems txe_elems eve_elems>
      The 'offset' is an address offset of the Message RAM where
      the following elements start from. This is usually set to
      0x0 if you're using a private Message RAM. The remain cells
      are used to specify how many elements are used for each FIFO/Buffer.

      MFBSP CAN includes the following elements according to user manual:
      11-bit Filter	0-128 elements / 0-128 words
      29-bit Filter	0-64 elements / 0-128 words
      Rx FIFO 0	0-64 elements / 0-384 words
      Tx Buff	0-32 elements / 0-192 words
      Tx Event FIFO	0-32 elements / 0-128 words
      Events	0-64 elements / 0-128 words

      Please refer user manual for details.
    $ref: /schemas/types.yaml#/definitions/int32-array
    items:
      items:
        - description: The 'offset' is an address offset of the Message RAM where
            the following elements start from. This is usually set to 0x0 if
            you're using a private Message RAM.
          default: 0
        - description: 11-bit Filter 0-128 elements / 0-128 words
          minimum: 0
          maximum: 128
        - description: 29-bit Filter 0-64 elements / 0-128 words
          minimum: 0
          maximum: 64
        - description: Rx FIFO 0-64 elements / 0-384 words
          minimum: 0
          maximum: 64
        - description: Tx Buff 0-32 elements / 0-128 words
          minimum: 0
          maximum: 32
        - description: Tx Event FIFO 0-32 elements / 0-128 words
          minimum: 0
          maximum: 32
        - description: Events 0-64 elements / 0-128 words
          minimum: 0
          maximum: 64
    maxItems: 1

required:
  - compatible
  - reg
  - reg-names
  - interrupt-parent
  - interrupts
  - clocks
  - elvees,mram-cfg

additionalProperties: false

examples:
  - |
  mfbsp0_can: mfbsp@1f0a0000 {
    compatible = "elvees,mfbsp-can";
    reg = <0x0 0x1f0a0000 0x0 0x0200>,
          <0x0 0x1f0a0200 0x0 0x1100>,
          <0x0 0x1f0a1380 0x0 0x0040>;
    reg-names = "can",
                "filters_and_elements",
                "cfg";
    interrupt-parent = <&qlic0>;
    interrupts = <26>;
    clocks = <&service_ucg1 SERVICE_MFBSP0_CLK>;
    elvees,mram-cfg = <0x0 128 64 64 32 32 64>;
  };
```
