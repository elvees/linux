## Documentation/devicetree/bindings/pinctrl/snps-dwapb-gpio.txt
```
* Synopsys DesignWare APB GPIO controller

Required properties:
- compatible : Should contain "snps,dw-apb-gpio"
- reg : Address and length of the register set for the device.
- #address-cells : should be 1 (for addressing port subnodes).
- #size-cells : should be 0 (port subnodes).

The GPIO controller has a configurable number of ports, each of which are
represented as child nodes with the following properties:

Required properties:
- compatible : "snps,dw-apb-gpio-port"
- gpio-controller : Marks the device node as a gpio controller.
- #gpio-cells : Should be two.  The first cell is the pin number and
  the second cell is used to specify the gpio polarity:
      0 = active high
      1 = active low
- reg : The integer port index of the port, a single cell.

Optional properties:
- interrupt-controller : The first port may be configured to be an interrupt
controller.
- #interrupt-cells : Specifies the number of cells needed to encode an
  interrupt.  Shall be set to 2.  The first cell defines the interrupt number,
  the second encodes the triger flags encoded as described in
  Documentation/devicetree/bindings/interrupt-controller/interrupts.txt
- interrupts : The interrupts to the parent controller raised when GPIOs
  generate the interrupts. If the controller provides one combined interrupt
  for all GPIOs, specify a single interrupt. If the controller provides one
  interrupt for each GPIO, provide a list of interrupts that correspond to each
  of the GPIO pins. When specifying multiple interrupts, if any are unconnected,
  use the interrupts-extended property to specify the interrupts and set the
  interrupt controller handle for unused interrupts to 0.
- snps,nr-gpios : The number of pins in the port, a single cell.
- resets : Reset line for the controller.

Optional properties for multiplexing:
- snps,has-mux: register the pinctrl controller if GPIO_HW_PORT{A,B,C,D}
  hardware configuration parameter is activated. This parameter requires
  "gpio-ranges".
- snps,mux-individual-pins: enable multiplexing individual pin in a port if
  hardware configuration parameter GPIO_PORT{A,B,C,D}_SINGLE_CTL is deactivated.
- gpio-ranges: Used for interaction with the PINCTRL subsystem, it requires 4
  fields in cells defined as:
      1. Phandle of pin-controller.
      2. GPIO base pin offset, should be 0.
      3  Pin-control base pin offset, should be 0.
      4. number of gpio pins.

Required properties for pin configuration node:
- function: String representing a function to mux. Must be set to "HW" if there
  is a need to use the pin/pins in hardware mode. Otherways the pin can be
  requested from the gpio subsystem(from other drivers or userspace) to be used
  in software mode.
- groups: List of pins to which the configuration applies. The array of pins
  names in a port starts with 'pin0' and ends with 'pin[snps,nr-gpios - 1]'.
  If the port doesn't support 'snps,mux-individual-pins' property then it will
  have one group according to the port name 'gpio{A,B,C,D}_grp', this group
  will have the same amount of pins in 'snps,nr-gpios' property.

Example:

gpio: gpio@20000 {
	compatible = "snps,dw-apb-gpio";
	reg = <0x20000 0x1000>;
	#address-cells = <1>;
	#size-cells = <0>;

	porta: gpio-controller@0 {
		compatible = "snps,dw-apb-gpio-port";
		gpio-controller;
		#gpio-cells = <2>;
		snps,nr-gpios = <8>;
		reg = <0>;
		interrupt-controller;
		#interrupt-cells = <2>;
		interrupt-parent = <&vic1>;
		interrupts = <0>;
	};

	portb: gpio-controller@1 {
		compatible = "snps,dw-apb-gpio-port";
		gpio-controller;
		#gpio-cells = <2>;
		snps,nr-gpios = <8>;
		reg = <1>;
		snps,has-mux;
		snps,mux-individual-pins;
		gpio-ranges = <&portb 0 0 8>;

		uart0_default: uart0-default {
			/* pins = tx, rx */
			groups = "pin0", "pin1";
			function = "HW";
		};
	};
};
```
