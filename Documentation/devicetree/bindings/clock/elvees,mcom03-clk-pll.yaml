## Documentation/devicetree/bindings/pinctrl/elvees,pinctrl-mcom03-lsperiph.yaml
```yaml
# SPDX-License-Identifier: GPL-2.0+
%YAML 1.2
---
$id: http://devicetree.org/schemas/pinctrl/elvees,pinctrl-mcom03-lsperiph.yaml#
$schema: http://devicetree.org/meta-schemas/core.yaml#

title: Pin controller for LSPERIPH0/1 subsystems in ELVEES MCom-03 SoC

maintainers:
  - Omar Al-Wadi <oalwadi@elvees.com>

properties:
  compatible:
    oneOf:
      - items:
          - const: elvees,mcom03-lsperiph0-pinctrl
      - items:
          - const: elvees,mcom03-lsperiph1-pinctrl

  elvees,urb:
    $ref: /schemas/types.yaml#/definitions/phandle
    description:
      A phandle to the syscon node describing URB registers.
  '#address-cells':
    const: 0
  '#size-cells':
    const: 0

required:
  - compatible
  - elvees,urb
  - '#address-cells'
  - '#size-cells'

patternProperties:
  "^(uart[1-3]|spi0|i2c0).*-cfg$":
    type: object
    description: |
      Config nodes for LSPERIPH0 pinctrl.
    patternProperties:
      ".*-(pins|pin)$":
        type: object
        properties:
          pins:
            items:
              oneOf:
                - enum: [GPIOA_0, GPIOA_1, GPIOA_2, GPIOA_3,
                         GPIOA_4, GPIOA_5, GPIOA_6, GPIOA_7,
                         GPIOB_0, GPIOB_1, GPIOB_2, GPIOB_3,
                         GPIOB_4, GPIOB_5, GPIOB_6, GPIOB_7,
                         GPIOC_0, GPIOC_1, GPIOC_2, GPIOC_3,
                         GPIOC_4, GPIOC_5, GPIOC_6, GPIOC_7,
                         GPIOD_0, GPIOD_1, GPIOD_2, GPIOD_3,
                         GPIOD_4, GPIOD_5, GPIOD_6, GPIOD_7]
            minItems: 1
            maxItems: 13 # Maximum pins(depends on uart3) number per one config.
          bias-disable:
            $ref: pincfg-node.yaml#/properties/bias-disable
            default: false
          bias-pull-up:
            $ref: pincfg-node.yaml#/properties/bias-pull-up
            default: true
        additionalProperties: false

  "^(i2c[1-3]|i2s0|uart0|ss1|timers-tog[0-1]|pwm-(oen(a|b)|tu)[0-1]).*-cfg$":
    type: object
    description: |
      Config nodes for LSPERIPH1 pinctrl pins.
    patternProperties:
      ".*-(pins|pin)$":
        type: object
        description: >
          Every property will be set to default value unless it is
          specified in DeviceTree for a certain pin.
        properties:
          pins:
            items:
              oneOf:
                - enum: [GPIOA_0, GPIOA_1, GPIOA_2, GPIOA_3,
                         GPIOA_4, GPIOA_5, GPIOA_6, GPIOA_7,
                         GPIOB_0, GPIOB_1, GPIOB_2, GPIOB_3,
                         GPIOB_4, GPIOB_5, GPIOB_6, GPIOB_7,
                         GPIOC_0, GPIOC_1, GPIOC_2, GPIOC_3,
                         GPIOC_4, GPIOC_5, GPIOC_6, GPIOC_7,
                         GPIOD_0, GPIOD_1, GPIOD_2, GPIOD_3,
                         GPIOD_4, GPIOD_5, GPIOD_6, GPIOD_7]
            minItems: 1
            maxItems: 8 # Maximum pins(depends on ss1) number per one config.

          bias-disable:
            $ref: pincfg-node.yaml#/properties/bias-disable
            default: true
          bias-bus-hold:
            $ref: pincfg-node.yaml#/properties/bias-bus-hold
            default: false
          bias-pull-up:
            $ref: pincfg-node.yaml#/properties/bias-pull-up
            default: false
          bias-pull-down:
            $ref: pincfg-node.yaml#/properties/bias-pull-down
            default: false
          drive-open-drain:
            $ref: pincfg-node.yaml#/properties/drive-open-drain
            default: false
          drive-strength:
            $ref: pincfg-node.yaml#/properties/drive-strength
            enum: [0, 2, 4, 6, 8, 10, 12]
            description: 0mA puts the pads in high impedance mode.
            default: 6
          input-enable:
            $ref: pincfg-node.yaml#/properties/input-enable
            description: Enable input on a line
            default: false
          input-disable:
            $ref: pincfg-node.yaml#/properties/input-disable
            description: Disable input on a line
            default: true
          slew-rate:
            $ref: pincfg-node.yaml#/properties/slew-rate
            enum: [0, 3]
            default: 3
            description: |
              0: Lower Slew rate (slower edges)
              3: Higher Slew rate (faster edges)

        additionalProperties: false

  "^all.*":
    type: object
    $ref: pincfg-node.yaml#
    description: |
      Config node for LSPERIPH1 pinctrl group.
    properties:
      groups:
        enum: [all]

      power-source:
        $ref: pincfg-node.yaml#/properties/power-source
        enum: [1800, 3300]
        description: 1800 is for 1.8V mode, 3300 is for 3.3V mode.
        default: 3300

    additionalProperties: false

additionalProperties: false

examples:
  - |
    lsperiph1_pinctrl: lsperiph1-pinctrl {
      compatible = "elvees,mcom03-lsperiph1-pinctrl";
      #address-cells = <0>;
      #size-cells = <0>;
      elvees,urb = <&lsperiph1_urb>;

      i2c1_default_cfg: i2c1-cfg {
        scl-sda-pins {
          pins = "GPIOA_0", "GPIOA_1";
          input-enable;
        };
      };

      i2c2_default_cfg: i2c2-cfg {
        scl-sda-pins {
          pins = "GPIOA_2", "GPIOA_3";
          input-enable;
        };
      };

      i2c3_default_cfg: i2c3-cfg {
        scl-sda-pins {
          pins = "GPIOA_4", "GPIOA_5";
          input-enable;
        };
      };

      i2s0_default_cfg: i2s0-cfg {
        sdi-sclkin-pins {
          pins = "GPIOB_4", "GPIOB_5";
          input-enable;
        };
      };

      uart0_default_cfg: uart0-cfg {
        rx-pin {
          pins = "GPIOB_7";
          bias-bus-hold;
          input-enable;
        };
      };
    };

  - |
    lsperiph0_pinctrl: lsperiph0-pinctrl {
      compatible = "elvees,mcom03-lsperiph0-pinctrl";
      #address-cells = <0>;
      #size-cells = <0>;
      elvees,urb = <&lsperiph0_urb>;

      uart3_default_cfg: uart3-default-cfg {
        tx-pin {
          pins = "GPIOA_1";
          bias-disable;
        };
      };
    };
```

## Documentation/devicetree/bindings/pinctrl/elvees,pinctrl-mcom03-media.yaml
```yaml
# SPDX-License-Identifier: GPL-2.0+
%YAML 1.2
---
$id: http://devicetree.org/schemas/pinctrl/elvees,pinctrl-mcom03-media.yaml#
$schema: http://devicetree.org/meta-schemas/core.yaml#

title: Pin controller for MEDIA subsystem in ELVEES MCom-03 SoC

maintainers:
  - Omar Al-Wadi <oalwadi@elvees.com>

properties:
  compatible:
    const: "elvees,mcom03-media-pinctrl"
  elvees,urb:
    $ref: /schemas/types.yaml#/definitions/phandle
    description:
      A phandle to the syscon node describing URB registers.
  '#address-cells':
    const: 0
  '#size-cells':
    const: 0

patternProperties:
  '.*-mux$':
    type: object
    properties:
      groups:
        $ref: "/schemas/types.yaml#/definitions/string"
        enum: [media_mux_grp]
      function:
        $ref: "/schemas/types.yaml#/definitions/string"
        enum: [ISP, DP]


required:
  - compatible
  - elvees,urb
  - '#address-cells'
  - '#size-cells'

additionalProperties: false

examples:
  - |
    media_pinctrl: media-pinctrl {
      compatible = "elvees,mcom03-media-pinctrl";
      #address-cells = <0>;
      #size-cells = <0>;
      elvees,urb = <&media_urb>;

      display_processor_mux: display-processor-mux {
        groups = "media_mux_grp";
        function = "DP";
      };

      isp_mux: isp-mux {
        groups = "media_mux_grp";
        function = "ISP";
      };
    };
```

## Documentation/devicetree/bindings/pinctrl/snps,dw-apb-gpio.yaml
```yaml
# SPDX-License-Identifier: (GPL-2.0 OR BSD-2-Clause)
%YAML 1.2
---
$id: http://devicetree.org/schemas/gpio/snps,dw-apb-gpio.yaml#
$schema: http://devicetree.org/meta-schemas/core.yaml#

title: Synopsys DesignWare APB GPIO controller

description: |
  Synopsys DesignWare GPIO controllers have a configurable number of ports,
  each of which are intended to be represented as child nodes with the generic
  GPIO-controller properties as desribed in this bindings file.

maintainers:
  - Hoan Tran <hoan@os.amperecomputing.com>
  - Serge Semin <fancer.lancer@gmail.com>

properties:
  $nodename:
    pattern: "^gpio@[0-9a-f]+$"

  compatible:
    const: snps,dw-apb-gpio

  "#address-cells":
    const: 1

  "#size-cells":
    const: 0

  reg:
    maxItems: 1

  clocks:
    minItems: 1
    items:
      - description: APB interface clock source
      - description: DW GPIO debounce reference clock source

  clock-names:
    minItems: 1
    items:
      - const: bus
      - const: db

  resets:
    maxItems: 1

  snps,has-mux:
    description: |
      register the pinctrl controller if GPIO_HW_PORT{A,B,C,D} hardware
      configuration parameter is activated. This parameter requires
      "gpio-ranges".

  snps,mux-individual-pins:
    description: |
      enable multiplexing individual pin in a port if hardware configuration
      parameter GPIO_PORT{A,B,C,D}_SINGLE_CTL is deactivated.

  gpio-ranges:
    description: >
      Used for interaction with the PINCTRL subsystem, it requires 4 fields in
      cells defined as:
       1. Phandle of pin-controller.
       2. GPIO base pin offset, should be 0.
       3  Pin-control base pin offset, should be 0.
       4. number of gpio pins.

patternProperties:
  "^gpio-(port|controller)@[0-9a-f]+$":
    type: object
    description: >
      Required properties for pin configuration node:
      - function: String representing a function to mux. Must be set to "HW"
        if there is a need to use the pin/pins in hardware mode. Otherways the
        pin can be requested from the gpio subsystem(from other drivers or
        userspace) to be used in software mode.
      - groups: List of pins to which the configuration applies. The array of
        pins names in a port starts with 'pin0' and ends with
        'pin[snps,nr-gpios - 1]'. If the port doesn't support
        'snps,mux-individual-pins' property then it will have one group
        according to the port name 'gpio{A,B,C,D}_grp', this group will have the
        same amount of pins in 'snps,nr-gpios' property.
    properties:
      compatible:
        const: snps,dw-apb-gpio-port

      reg:
        maxItems: 1

      gpio-controller: true

      '#gpio-cells':
        const: 2

      ngpios:
        default: 32
        minimum: 1
        maximum: 32

      snps,nr-gpios:
        description: The number of GPIO pins exported by the port.
        deprecated: true
        $ref: /schemas/types.yaml#/definitions/uint32
        default: 32
        minimum: 1
        maximum: 32

      interrupts:
        description: |
          The interrupts to the parent controller raised when GPIOs generate
          the interrupts. If the controller provides one combined interrupt
          for all GPIOs, specify a single interrupt. If the controller provides
          one interrupt for each GPIO, provide a list of interrupts that
          correspond to each of the GPIO pins.
        minItems: 1
        maxItems: 32

      interrupt-controller: true

      '#interrupt-cells':
        const: 2

    required:
      - compatible
      - reg
      - gpio-controller
      - '#gpio-cells'

    dependencies:
      interrupt-controller: [ interrupts ]

    additionalProperties: false

additionalProperties: false

required:
  - compatible
  - reg
  - "#address-cells"
  - "#size-cells"

examples:
  - |
    gpio: gpio@20000 {
      compatible = "snps,dw-apb-gpio";
      reg = <0x20000 0x1000>;
      #address-cells = <1>;
      #size-cells = <0>;

      porta: gpio-port@0 {
        compatible = "snps,dw-apb-gpio-port";
        reg = <0>;
        gpio-controller;
        #gpio-cells = <2>;
        snps,nr-gpios = <8>;
        interrupt-controller;
        #interrupt-cells = <2>;
        interrupt-parent = <&vic1>;
        interrupts = <0>;
      };

      portb: gpio-port@1 {
        compatible = "snps,dw-apb-gpio-port";
        reg = <1>;
        gpio-controller;
        #gpio-cells = <2>;
        snps,nr-gpios = <8>;
        snps,has-mux;
        snps,mux-individual-pins;
        gpio-ranges = <&portb 0 0 8>;

        uart0_default: uart0-default {
          /* pins = tx, rx */
          groups = "pin0", "pin1";
          function = "HW";
        };
      };
    };
...
```
