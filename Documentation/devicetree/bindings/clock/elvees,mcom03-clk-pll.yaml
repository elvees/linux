## Documentation/devicetree/bindings/display/elvees,mcom03-drm-dsi.yaml
```yaml
# SPDX-License-Identifier: (GPL-2.0-only OR BSD-2-Clause)
%YAML 1.2
---
$id: http://devicetree.org/schemas/display/elvees,mcom03-drm-dsi.yaml#
$schema: http://devicetree.org/meta-schemas/core.yaml#

title: ELVEES MCom-03 DSI display encoder

maintainers:
  - RnD Center ELVEES, JSC <support@elvees.com>

description:
  MCom-03 DSI display encoder.

properties:
  compatible:
    const: elvees,mcom03-drm-dsi

  reg:
    items:
      - description: DSI controller
      - description: MIPI TX DPHY control registers

  reg-names:
    items:
      - const: dsi
      - const: mipi-tx

  clocks:
    items:
      - description: Pixel clock
      - description: pclk clock
      - description: disp_aclk clock
      - description: mipi_tx_cfg clock
      - description: mipi_tx_ref clock
      - description: mipi_txlkesc_ref clock

  clock-names:
    items:
      - const: pxlclk
      - const: pclk
      - const: disp_aclk
      - const: mipi_tx_cfg
      - const: mipi_tx_ref
      - const: mipi_txclkesc

  ports:
    $ref: /schemas/graph.yaml#/properties/ports

    properties:
      port@0:
        $ref: /schemas/graph.yaml#/properties/port
        description: Input port from CRTC device

      port@1:
        $ref: /schemas/graph.yaml#/properties/port
        description: Output port for DSI interface

    required:
      - port@0

  elvees,urb:
    $ref: /schemas/types.yaml#/definitions/phandle
    description: Handle to URB of Media subsystem

  dsi-clock-frequency:
    description:
      Custom DSI output frequency in hertz. Sometimes it is required to set
      DSI frequency higher than automatically calculated from pixel clock.
      By default (or if specified 0) DSI clock will be equal to minimum
      frequency sufficient for pixel clock.
    default: 0

  dsi-min-clock-frequency:
    description:
      Minimal DSI output frequency in hertz. Sometimes low pixel clock modes
      could be unstable with some dsi devices. This option overrides calculated
      DSI frequency for pixel clocks lower then defined value.
    default: 0


required:
  - compatible
  - reg
  - reg-names
  - clocks
  - clock-names
  - ports

additionalProperties: false

examples:
  - |
    #include <dt-bindings/gpio/gpio.h>
    #include <dt-bindings/clock/mcom03-clock.h>

    dsi_panel: dsi-panel {
        #address-cells = <1>;
        #size-cells = <0>;
        compatible = "auo,b101uan01";
        status = "okay";
        backlight = <&dsi_backlight>;
        enable-gpios = <&gpio1c 1 GPIO_ACTIVE_HIGH>;

        ports {
            port {
                panel_in: endpoint {
                    remote-endpoint = <&dsi_out>;
                };
            };
        };
    };

    de_dsi: display-encoder@12c0000 {
        compatible = "elvees,mcom03-drm-dsi";
        reg = <0x12c0000 0x10000>,
              <0x1324000 0x1000>;
        reg-names = "dsi", "mipi-tx";
        clocks = <&media_ucg1 CLK_MEDIA_UCG1_DISP_PXL>,
            <&media_ucg0 CLK_MEDIA_UCG0_SYSA>,
            <&media_ucg1 CLK_MEDIA_UCG1_DISP_A>,
            <&media_ucg3 CLK_MEDIA_UCG3_MIPI_TX_CFG>,
            <&media_ucg3 CLK_MEDIA_UCG3_MIPI_TX_REF>,
            <&media_ucg3 CLK_MEDIA_UCG3_MIPI_TXCLKESC>;
        clock-names = "pxlclk", "pclk", "disp_aclk", "mipi_tx_cfg",
                      "mipi_tx_ref", "mipi_txclkesc";
        elvees,urb = <&media_urb>;
        dsi-clock-frequency = <500000000>;

        ports {
            #address-cells = <1>;
            #size-cells = <0>;

            port@0 {
                reg = <0>;
                de_dsi_in: endpoint {
                    remote-endpoint = <&crtc_out>;
                };
            };

            port@1 {
                reg = <1>;
                dsi_out: endpoint {
                    remote-endpoint = <&panel_in>;
                };
            };
        };
    };

...
```

## Documentation/devicetree/bindings/gnss/u-blox-spi.yaml
```yaml
# SPDX-License-Identifier: GPL-2.0
%YAML 1.2
---
$id: http://devicetree.org/schemas/gnss/u-blox-spi.yaml#
$schema: http://devicetree.org/meta-schemas/core.yaml#

title: U-blox SPI-connected GNSS receiver bindings

maintainers:
  - Vasiliy Zasukhin <vzasukhin@elvees.com>

properties:
  compatible:
    enum:
      - u-blox,zoe-m8b-spi

  reg:
    maxItems: 1

  reset-gpios:
    maxItems: 1
    $ref: /schemas/types.yaml#/definitions/uint8
    description: GPIO, that connected to RESET pin

required:
  - compatible
  - reg

additionalProperties: false

examples:
  - |
    spi {
        gnss@3 {
            compatible = "u-blox,zoe-m8b-spi";
            reg = <3>;
            spi-max-frequency = <1000000>;
        };
    };
...
```

## Documentation/devicetree/bindings/gpio/elvees,mfbsp-gpio.yaml
```yaml
# SPDX-License-Identifier: GPL-2.0-only OR BSD-2-Clause
%YAML 1.2
---
$id: http://devicetree.org/schemas/gpio/elvees,mfbsp-gpio.yaml#
$schema: http://devicetree.org/meta-schemas/core.yaml#

title: ELVEES MFBSP-GPIO controller

maintainers:
  - Ilya Popov <ipopov@elvees.com>

description: |+
  Bindings for the ELVEES MFBSP-GPIO controller.

  These bindings can be used on MCom-03 SoC.

  MFBSP is multifunctional device, but MFBSP-GPIO driver is agnostic to other
  functions. MFBSP-GPIO driver is based on Generic GPIO driver. MFBSP-GPIO
  supports maximum of 10 gpio lines. If I2S/SPI function of MFBSP is used
  only 4 GPIO lines (LDAT4...LDAT7) should be used according to SoC
  documentation. If CAN or LPORT function of MFBSP is used then no GPIO lines
  should be used.

properties:
  compatible:
    enum:
      - elvees,mfbsp-gpio

  gpio-controller: true

  "#gpio-cells":
    const: 2

  gpio-reserved-ranges:
    maxItems: 2
    description: |
      Usage of MFBSP-GPIO lines must be restricted if other functions of MFBSP
      are used. See gpio.txt for more information on how to use this option.

  native-endian: true

  reg:
    maxItems: 2

  reg-names:
    items:
      - const: dat
      - const: dirout

  clocks:
    maxItems: 1

  clock-names:
    items:
      - const: bus

required:
  - compatible
  - reg
  - reg-names
  - gpio-controller
  - '#gpio-cells'
  - clocks
  - clock-names


additionalProperties: false

examples:
  - |
    gpio-controller@0x1f0a1300 {
      compatible = "evlees,mfbsp-gpio";
      reg-names = "dat", "dirout";
      clocks = <&service_ucg1 5>;
      clock-names = "bus";
      reg = <0 0x1f0a1308 0 4>, <0 0x1f0a130c 0 4>;
      gpio-controller;
      #gpio-cells = <2>;
      gpio-reserved-ranges = <0 6>, <10 21>;
    };
```

## Documentation/devicetree/bindings/gpio/pericom,pi4ioe5v6408.yaml
```yaml
# SPDX-License-Identifier: (GPL-2.0-only OR BSD-2-Clause)
%YAML 1.2
---
$id: http://devicetree.org/schemas/gpio/pericom,pi4ioe5v6408.yaml#
$schema: http://devicetree.org/meta-schemas/core.yaml#

title: PI4IOE5V6408 I2C GPIO expander

maintainers:
  - Ilya Popov  <ipopov@elvees.com>

properties:
  compatible:
    enum:
      - pericom,pi4ioe5v6408

  reg:
    maxItems: 1

  gpio-controller: true

  '#gpio-cells':
    const: 2

required:
  - compatible
  - reg
  - gpio-controller
  - "#gpio-cells"

additionalProperties: false

examples:
  - |
    i2c0 {
        #address-cells = <1>;
        #size-cells = <0>;

        gpio@43 {
            compatible = "pericom,pi4ioe5v6408";
            reg = <0x43>;
            gpio-controller;
            #gpio-cells = <2>;
        };
    };

...
```

## Documentation/devicetree/bindings/hwmon/gpio-alarm.yaml
```yaml
# SPDX-License-Identifier: GPL-2.0-only or BSD-2-Clause
%YAML 1.2
---
$id: http://devicetree.org/schemas/hwmon/gpio-alarm.yaml#
$schema: http://devicetree.org/meta-schemas/core.yaml#

title: Alarms connected to GPIO lines

maintainers:
  - Oleg Ivanov <oaivanov@elvees.com>

properties:
  compatible:
    enum:
      - gpio-alarm

  temp-gpios:
    description:
      This pin going active indicates temp alarm.

  intrusion-gpios:
    description:
      This pin going active indicates intrusion alarm.

required:
  - compatible

anyOf:
  - required:
      - temp-gpios
  - required:
      - intrusion-gpios

additionalProperties: false

examples:
  - |
    #include <dt-bindings/gpio/gpio.h>
    gpio-alarm {
      compatible = "gpio-alarm";
      temp-gpios = <&gpio0a 1 GPIO_ACTIVE_LOW>,
                   <&gpio0a 2 GPIO_ACTIVE_LOW>;
      intrusion-gpios = <&gpio0a 3 GPIO_ACTIVE_LOW>,
                        <&gpio0a 4 GPIO_ACTIVE_LOW>;
    };
```

## Documentation/devicetree/bindings/hwmon/moortec,mr75202.yaml
```yaml
# SPDX-License-Identifier: GPL-2.0
%YAML 1.2
---
$id: http://devicetree.org/schemas/hwmon/moortec,mr75202.yaml#
$schema: http://devicetree.org/meta-schemas/core.yaml#

title: Moortec Semiconductor MR75202 PVT Controller bindings

maintainers:
  - Anton Leontiev <aleontiev@elvees.com>

description: |
  Moortec MR75202 PVT controller is used to configure & control Moortec
  embedded analog IPs like temperature sensors (TS), voltage monitors (VM) and
  process detectors (PD).

properties:
  compatible:
    const: moortec,mr75202

  reg:
    maxItems: 1

  clocks:
    maxItems: 1

  resets:
    maxItems: 1

  "#thermal-sensor-cells":
    const: 1

  moortec,name:
    $ref: /schemas/types.yaml#/definitions/string
    description: Name of hardware monitoring device. If omitted, "mr75202" is
      used.

  moortec,labels:
    $ref: /schemas/types.yaml#/definitions/string-array
    description: Channel labels proposed by driver. If omitted default labels
      are used by hwmon subsystem.

required:
  - compatible
  - reg
  - clocks
  - "#thermal-sensor-cells"

additionalProperties: false

examples:
  - |
    pvt@1f050000 {
        compatible = "moortec,mr75202";
        reg = <0 0x1f050000 0 0x1000>;
        clocks = <&ucg0 1>;
        moortec,name = "internal";
        moortec,labels = "north", "east", "south", "west";
        resets = <&urg0 1>;
        #thermal-sensor-cells = <1>;
    };
```

## Documentation/devicetree/bindings/iio/imu/qst,qmi8658c.yaml
```yaml
# SPDX-License-Identifier: (GPL-2.0 OR BSD-2-Clause)
%YAML 1.2
---
$id: http://devicetree.org/schemas/iio/imu/qst,qmi8658c.yaml#
$schema: http://devicetree.org/meta-schemas/core.yaml#

title: QST QMI8658 IMU

maintainers:
  - Orazov Ilya <iorazov@elvees.com>

description: |
  Low Noise, Wide Bandwidth 6D Inertial Measurement
  Unit with Motion Co-Processor and Sensor Fusion
  https://www.qstcorp.com/upload/pdf/202202/（已传）QMI8658C datasheet rev 0.9.pdf

properties:
  compatible:
    const: qst,qmi8658c

  reg:
    maxItems: 1

  interrupts:
    maxItems: 2

  interrupt-names:
    items:
      - const: INT1
      - const: INT2
    description: |
      INT1 is used as part of the CTRL9 handshake protocol and
      can indicate Wake On Motion.
      INT2 generally indicates data availability and can be
      used for motion detection event interrupt.

  mount-matrix:
    description: an optional 3x3 mounting rotation matrix

required:
  - compatible
  - reg

additionalProperties: false

examples:
  - |
    #include <dt-bindings/interrupt-controller/irq.h>
    i2c2 {
        #address-cells = <1>;
        #size-cells = <0>;

        qmi8658c: imu@6b {
            compatible = "qst,qmi8658c";
            reg = <0x6b>;
            interrupt-parent = <&gpio0a>;
            interrupts = <5 IRQ_TYPE_LEVEL_HIGH>,
                         <4 IRQ_TYPE_LEVEL_HIGH>;
            interrupt-names = "INT1", "INT2";
            mount-matrix = "0", "1", "0",
                           "1", "0", "0",
                           "0", "0", "-1";
        };
    };
```

## Documentation/devicetree/bindings/iio/proximity/vishay,vcnl36821s.yaml
```yaml
# SPDX-License-Identifier: (GPL-2.0 OR BSD-2-Clause)
%YAML 1.2
---
$id: http://devicetree.org/schemas/iio/proximity/vishay,vcnl36821s.yaml#
$schema: http://devicetree.org/meta-schemas/core.yaml#

title: Integrated proximity sensor with infrared emitter

maintainers:
  - Timur Prokopenko <tprokopenko@elvees.com>

description: |
  The VCNL36821S is a fully integrated proximity sensor. It combines
  an infrared emitter and photodiode for proximity measurement and
  signal processing IC in a single package with a 12-bit ADC.

  Through its standard I2C bus serial digital interface, it allows
  easy access to a “proximity signal”. The programmable
  interrupt function offers wake-up functionality for the
  microcontroller when a proximity change occurs, which
  reduces processing overhead by eliminating the need for
  continuous polling.

  Specifications about the devices can be found at:
  https://www.vishay.com/docs/80178/designingvcnl36821s.pdf

properties:
  compatible:
    enum:
      - vishay,vcnl36821s

  reg:
    maxItems: 1

  interrupts:
    maxItems: 1

  vishay,led-current:
    description:
      The driver current for the LED used in proximity sensing in mA.
    $ref: /schemas/types.yaml#/definitions/uint32
    enum: [50, 66, 82, 98, 114, 130, 144, 156]

  vishay,sunlight-cancellation:
    description: Enable sunlight cancellation
    type: boolean

required:
  - compatible
  - reg

additionalProperties: false

examples:
  - |
    i2c {
        #address-cells = <1>;
        #size-cells = <0>;
        proximity-sensor@60 {
              compatible = "vishay,vcnl36821s";
              reg = <0x60>;
              vishay,led-current = <156>;
              vishay,sunlight-cancellation;
        };
    };
```

## Documentation/devicetree/bindings/interrupt-controller/elvees,qlic.yaml
```yaml
# SPDX-License-Identifier: GPL-2.0-only OR BSD-2-Clause
%YAML 1.2
---
$id: http://devicetree.org/schemas/interrupt-controller/elvees,qlic.yaml#
$schema: http://devicetree.org/meta-schemas/core.yaml#
title: ELVEES QLIC Interrupt Controller

maintainers:
  - Georgy Macharadze <gmacharadze@elvees.com>

description: Bindings for the ELVEES QLIC Interrupt controller.

properties:
  compatible:
    const: elvees,qlic

  interrupt-controller: true

  targets:
    description: |
      Specifies QLIC targets to parent interrupt controller. Each
      target corresponds to an interrupt in "interrupt" property.

  "#interrupt-cells":
    const: 1

  interrupts:
    items:
      - description: specifies the interrupts to parent interrupt controller

  reset-targets-mask:
    description: |
      It's 32-bit number, which masks interrupt targets that should be
      reseted by QLIC driver. If bit N is set in mask, then target N will be reseted by driver
      during initialization.

  reg:
    items:
      - description: specifies the base physical address for hardware

required:
  - compatible
  - interrupt-controller
  - targets
  - "#interrupt-cells"
  - interrupt-parent
  - interrupts
  - reg

additionalProperties: false

examples:
  - |
    #include <dt-bindings/interrupt-controller/arm-gic.h>

    service-bus {
      #address-cells = <2>;
      #size-cells = <2>;

      qlic0: interrupt-controller@1fe00000 {
        compatible = "elvees,qlic";
        interrupt-controller;
        targets = <4>;
        #interrupt-cells = <1>;
        interrupt-parent = <&gic>;
        reset-targets-mask = <0xF0>;
        interrupts = <GIC_SPI 8 IRQ_TYPE_LEVEL_HIGH>;
        reg = <0 0x1fe00000 0 0x40000>;
      };
    };
```
