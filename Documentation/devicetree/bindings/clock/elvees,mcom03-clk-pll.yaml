## Documentation/devicetree/bindings/clock/elvees,mcom03-clk-pll.yaml
```yaml
# SPDX-License-Identifier: GPL-2.0
%YAML 1.2
---
$id: http://devicetree.org/schemas/clock/elvees,mcom03-clk-pll.yaml#
$schema: http://devicetree.org/meta-schemas/core.yaml#

title: MCom-03 PLL

properties:
  compatible:
    enum:
      - elvees,mcom03-clk-pll

  clocks:
    maxItems: 1
    description: Input clock from XTI

  '#clock-cells':
    const: 0

  reg:
    maxItems: 1

  assigned-clocks: true

  assigned-clock-rates: true

  elvees,pll-max-nr:
    $ref: /schemas/types.yaml#/definitions/uint8
    description: |

      Maximal NR parameter for PLL setup. Large value increases the number of
      available frequencies that PLL can be tuned to, but increases output
      jitter.
      Driver try to use minimal NR parameter from range [1 ... pll_max_nr] to
      set requested frequency. If requested frequency can not be set accurately
      then driver will use nearest frequency that does not exceed the requested
      frequency.
    minimum: 1
    maximum: 64
    default: 1

required:
  - compatible
  - reg
  - clocks
  - '#clock-cells'

additionalProperties: false

examples:
  - |
    hsperiph_pll: hsperiph_pll {
        #clock-cells = <0>;
        compatible = "elvees,mcom03-clk-pll";
        reg = <0 0x10401000 0 0x8>;
        clocks = <&xti_clk>;
        elvees,pll-max-nr = /bits/ 8 <3>;
        assigned-clocks = <&hsperiph_pll>;
        assigned-clock-rates = <1125000000>;
    };
...
```

## Documentation/devicetree/bindings/clock/elvees,mcom03-clk-refmux.yaml
```yaml
# SPDX-License-Identifier: (GPL-2.0-only OR BSD-2-Clause)
%YAML 1.2
---
$id: http://devicetree.org/schemas/clock/elvees,mcom03-clk-refmux.yaml#
$schema: http://devicetree.org/meta-schemas/core.yaml#

title: MCom-03 REF MUX

maintainers:
  - Vasiliy Zasukhin <vzasukhin@elvees.com>

description: |
  MCom-03 SoC has several UCG (Universal Clock Generator). Some UCGs has up to
  four input reference clocks. Clock for UCG seleted by reference multiplexor
  (REF MUX). This file describes REF MUX. UCG is described in
  elvees,mcom03-clk-ucg.yaml.
             +---------+  +---------+
   clk_ref0--|         |  |         |- channel 0
   clk_ref1--| REF MUX |--|   UCG   |- channel 1
   clk_ref2--|         |  |         |...
   clk_ref3--|         |  |         |- channel 15
             +---------+  +---------+

properties:
  compatible:
    enum:
      - elvees,mcom03-clk-hsp-refmux0
      - elvees,mcom03-clk-hsp-refmux1
      - elvees,mcom03-clk-hsp-refmux2
      - elvees,mcom03-clk-hsp-refmux3
      - elvees,mcom03-clk-lsp1-refmux-i2s
      - elvees,mcom03-clk-sdr-refmux-pcie0
      - elvees,mcom03-clk-sdr-refmux-pcie1
      - elvees,mcom03-clk-sdr-refmux-jesd0tx
      - elvees,mcom03-clk-sdr-refmux-jesd0rx

  clocks:
    minItems: 1
    maxItems: 4
    description: Input clocks

  '#clock-cells':
    const: 0

  clock-output-names: true

  assigned-clocks: true

  assigned-clock-parents: true

required:
  - compatible
  - clocks
  - '#clock-cells'

additionalProperties: false

examples:
  - |
    hsperiph_refmux2: hsperiph_refmux2 {
        compatible = "elvees,mcom03-clk-hsp-refmux2";
        clocks = <&hsperiph_pll>, <&hsperiph_clk125_clk>;
        #clock-cells = <0>;
        assigned-clocks = <&hsperiph_refmux2>;
        assigned-clock-parents = <&hsperiph_clk125_clk>;
    };

    hsperiph_ucg2: ucg@10430000 {
        compatible = "elvees,mcom03-clk-ucg";
        reg = <0 0x10430000 0 0x80>;
        clocks = <&hsperiph_refmux2>;
        clock-output-names = "emac0_clk_1588",
                             "emac0_rgmii_txc",
                             "emac1_clk_1588",
                             "emac1_rgmii_txc";
        #clock-cells = <1>;
    };
...
```

## Documentation/devicetree/bindings/clock/elvees,mcom03-clk-ucg.yaml
```yaml
# SPDX-License-Identifier: GPL-2.0
%YAML 1.2
---
$id: http://devicetree.org/schemas/clock/elvees,mcom03-clk-ucg.yaml#
$schema: http://devicetree.org/meta-schemas/core.yaml#

title: MCom-03 UCG

maintainers:
  - Vasiliy Zasukhin <vzasukhin@elvees.com>

description: |
  MCom-03 SoC has several UCG (Universal Clock Generator). UCG has up to four
  reference clock inputs and up to 16 output channels. Each channel has
  own 20-bit divider and gate. All output channels use single reference clock.
  Some UCGs (in HSPERIPH, LSPERIPH1 and SDR subsystems) can use one of several
  (up to four) reference clocks. In this case reference clock for dividing
  can be selected by reference clock multiplexor (REF MUX).
  MCom-03 datasheet says that REF MUX is part of UCG, but in Linux using
  separate driver for REF MUX is more convenient. This file describes
  only UCG. REF MUX is described in elvees,mcom03-clk-refmux.yaml.
           +---------+   +-------------------+
           | REF MUX |   |         UCG       |
           |         |   |    +------------+ |
           |         |   | +--|-DIV---GATE-|-|- channel 0
  clk_ref0-|         |   | |  +------------+ |
  clk_ref1-|         |---|-+--|-DIV---GATE-|-|- channel 1
  clk_ref2-|         |   | |  +------------+ |
  clk_ref3-|         |   | +................ |...
           |         |   | |  +------------+ |
           |         |   | +--|-DIV---GATE-|-|- channel 15
           |         |   |    +------------+ |
           +---------+   +-------------------+

properties:
  compatible:
    enum:
      - elvees,mcom03-clk-ucg

  clocks:
    maxItems: 1
    description: Input clock

  '#clock-cells':
    const: 1

  reg:
    maxItems: 1

  clock-output-names: true

  clock-indices: true

  assigned-clocks: true

  assigned-clock-rates: true

  enabled-clocks:
    description: Channels that must be enabled at boot

  elvees,fixed-freq-mask:
    $ref: /schemas/types.yaml#/definitions/uint32
    description: Bitmask of channels which must not change frequency
    default: 0

  elvees,round-up-mask:
    $ref: /schemas/types.yaml#/definitions/uint32
    description: Bitmask of channels for which frequency must be rounded up
    default: 0

required:
  - compatible
  - reg
  - clocks
  - clock-output-names
  - '#clock-cells'

additionalProperties: false

examples:
  - |
    #include <dt-bindings/clock/mcom03-clock.h>
    media_ucg1: ucg@13200c0 {
        compatible = "elvees,mcom03-clk-ucg";
        reg = <0 0x13200c0 0 0x80>;
        clocks = <&media_pll1>;

        clock-output-names = "disp_aclk", "disp_mclk", "disp_pxlclk";
        assigned-clocks = <&media_ucg1 CLK_MEDIA_UCG1_DISP_A>,
                          <&media_ucg1 CLK_MEDIA_UCG1_DISP_M>;
        assigned-clock-rates = <297000000
                                148500000>;
        enabled-clocks = <CLK_MEDIA_UCG1_DISP_A>;
        #clock-cells = <1>;
    };
...
```

## Documentation/devicetree/bindings/clock/elvees,mcom03-dsp-gate.yaml
```yaml
# SPDX-License-Identifier: GPL-2.0
%YAML 1.2
---
$id: http://devicetree.org/schemas/clock/elvees,mcom03-clk-dsp-gate.yaml#
$schema: http://devicetree.org/meta-schemas/core.yaml#

title: MCom-03 DSP gate

properties:
  compatible:
    enum:
      - elvees,mcom03-dsp-gate

  clocks:
    maxItems: 1
    description: Input clock

  '#clock-cells':
    const: 1

  reg:
    maxItems: 1

  clock-output-names: true

required:
  - compatible
  - reg
  - clocks
  - clock-output-names
  - '#clock-cells'

additionalProperties: false

examples:
  - |
    dsp_gate: clock-controller@191004c {
        compatible = "elvees,mcom03-dsp-gate";
        reg = <0 0x191004c 0 0x4>;
        clocks = <&sdr_pll2>;
        clock-output-names = "dsp0_clk", "dsp1_clk";
        #clock-cells = <1>;
    };
...
```

## Documentation/devicetree/bindings/clock/elvees-mcom-clock.txt
```
* ELVEES MCom-02 device tree clock bindings

Required properties for PLL:

- compatible: should be "elvees,mcom-clk-pll".
- reg: shall be the register offset from CMCTR base.
- #clock-cells: should be 0
- clocks: shall be the input parent clock phandle for the clock.

Optional properties for PLL

- clk-mult-initial: set initial multiplier.


Required properties for divider:

- compatible: should be "elvees,mcom-clk-divider".
- reg: shall be the register offset from CMCTR base.
- #clock-cells: should be 0
- clocks: shall be the input parent clock phandle for the clock.
- reg-shift: bit shift of the divider field.
- reg-width: width of the divider field.

Optional properties for divider:

- clk-div-initial: write raw value into register. This is not a divider.
  Divider = 2 ^ clk-div-initial


Required properties for gate:

- compatible: should be "elvees,mcom-clk-gate".
- reg: shall be the register offset from CMCTR base.
- #clock-cells: should be 0
- clocks: shall be the input parent clock phandle for the clock.
- reg-bit: bit shift for the bit enabling/disabling the clock.


Required properties for mux:

- compatible: should be "elvees,mcom-clk-mux".
- reg: shall be the register offset from CMCTR base.
- #clock-cells: should be 0
- clocks: shall be the input parent clocks phandle for the clock.
- reg-shift: bit shift of the mux field.
- reg-width: width of the mux field.

Optional properties for mux:

- clk-mux-initial: write raw value into register (can be in range 0..7).


Example:

	clock-controller@38094000 {
		compatible = "elvees,mcom-cmctr";
		reg = <0x38094000 0x1000>;

		clocks {
			#address-cells = <1>;
			#size-cells = <0>;

			spllclk: spllclk {
				compatible = "elvees,mcom-clk-pll";
				clocks = <&xti24m>;
				#clock-cells = <0>;
				reg = <0x10c>;
				clk-mult-initial = <12>;
			};

			clkout_clk_mux: clkout_clk_mux {
				compatible = "elvees,mcom-clk-mux";
				clocks = <&spllclk>, <&cpllclk>, <&apllclk>,
					 <&dpllclk>, <&vpllclk>, <&swic0pllclk>,
					 <&swic1pllclk>;
				#clock-cells = <0>;
				reg = <0x80>;
				reg-shift = <0>;
				reg-width = <3>;
				clk-mux-initial = <0>;
			};

			clkout_clk_div: clkout_clk_div {
				compatible = "elvees,mcom-clk-divider";
				clocks = <&clkout_clk_mux>;
				#clock-cells = <0>;
				reg = <0x84>;
				reg-shift = <0>;
				reg-width = <2>;
				clk-div-initial = <0>;
			};

			clkout_clk: clkout_clk {
				compatible = "elvees,mcom-clk-gate";
				clocks = <&clkout_clk_div>;
				#clock-cells = <0>;
				reg = <0x88>;
				reg-bit = <0>;
			};
		};
	};
```

## Documentation/devicetree/bindings/display/elvees,mcom03-display-encoder.yaml
```yaml
# SPDX-License-Identifier: GPL-2.0
%YAML 1.2
---
$id: http://devicetree.org/schemas/display/elvees,mcom03-display-encoder.yaml#
$schema: http://devicetree.org/meta-schemas/core.yaml#

title: ELVEES MCom-03 display encoder

description:
  MCom-03 encoder is a virtual device representing DPI and DSI video output
  interfaces.

properties:
  compatible:
    const: elvees,mcom03-display-encoder

  reg:
    items:
      - description: DSI controller
      - description: MIPI TX DPHY control registers
    minItems: 2

  reg-names:
    items:
      - const: dsi
      - const: mipi-tx
    minItems: 2

  clocks:
    items:
      - description: Pixel clock
      - description: mipi_tx_cfg clock
      - description: mipi_tx_ref clock
    minItems: 3

  clock-names:
    items:
      - const: pxlclk
      - const: mipi_tx_cfg
      - const: mipi_tx_ref
    minItems: 3

  ports:
    $ref: /schemas/graph.yaml#/properties/ports

    properies:
      port@0:
        $ref: /schemas/graph.yaml#/properties/port
        description: Input port from CRTC device

      port@1:
        $ref: /schemas/graph.yaml#/properties/port
        description: Output port for DSI interface

      port@2:
        $ref: /schemas/graph.yaml#/properties/port
        description: Output port for RGB interface (except panels)

    required:
      - port@0

  video-output:
    oneOf:
      - const: rgb
      - const: dsi

  elvees,urb:
    description: Handle to URB of Media subsystem

  dsi-clock-frequency:
    description:
      Custom DSI output frequency in hertz. Sometimes it is required to set
      DSI frequency higher than automatically calculated from pixel clock.
      By default (or if specified 0) DSI clock will be equal to minimum
      frequency sufficient for pixel clock.
    default: 0

  panel:
    $ref: /schemas/types.yaml#/definitions/phandle
    description:
      Handle to panel. Used only for video-output "rgb". In this case
      port 2 is not used. For DSI panels this property is not used
      and required port 1.

required:
  - compatible
  - reg
  - reg-names
  - clocks
  - clock-names
  - ports
  - video-output

additionalProperties: false

examples:
  - |
    display_encoder: display-encoder {
        compatible = "elvees,mcom03-display-encoder";
        reg = <0 0x12c0000 0 0x10000
               0 0x1324000 0 0x18>;
        reg-names = "dsi", "mipi-tx";
        clocks = <&dp_pix_clk>, <&mipi_tx_ref_clk>, <&mipi_tx_ref_clk>;
        clock-names = "pxlclk", "mipi_tx_cfg", "mipi_tx_ref";
        elvees,urb = <&media_urb>;
        video-output = "rgb";

        ports {
            #address-cells = <1>;
            #size-cells = <0>;

            port@0 {
                reg = <0>;
                display_encoder_in: endpoint {
                    remote-endpoint = <&crtc_out>;
                };
            };

            port@2 {
                reg = <2>;
                rgb_out: endpoint {
                    remote-endpoint = <&adv7513_in>;
                };
            };
        };
    };

  - |
    display_encoder: display-encoder {
        compatible = "elvees,mcom03-display-encoder";
        reg = <0 0x12c0000 0 0x10000
               0 0x1324000 0 0x18>;
        reg-names = "dsi", "mipi-tx";
        clocks = <&dp_pix_clk>, <&mipi_tx_ref_clk>, <&mipi_tx_ref_clk>;
        clock-names = "pxlclk", "mipi_tx_cfg", "mipi_tx_ref";
        elvees,urb = <&media_urb>;
        video-output = "rgb";
        panel = <&panel_parallel>;

        ports {
            #address-cells = <1>;
            #size-cells = <0>;

            port@0 {
                reg = <0>;
                display_encoder_in: endpoint {
                    remote-endpoint = <&crtc_out>;
                };
            };
        };
    };

  - |
    display_encoder: display-encoder {
        compatible = "elvees,mcom03-display-encoder";
        reg = <0 0x12c0000 0 0x10000
               0 0x1324000 0 0x18>;
        reg-names = "dsi", "mipi-tx";
        clocks = <&dp_pix_clk>, <&mipi_tx_ref_clk>, <&mipi_tx_ref_clk>;
        clock-names = "pxlclk", "mipi_tx_cfg", "mipi_tx_ref";
        elvees,urb = <&media_urb>;
        video-output = "dsi";
        dsi-clock-frequency = <500000000>;

        panel0: dsi-panel {
            #address-cells = <1>;
            #size-cells = <0>;
            compatible = "auo,b101uan01";
            status = "okay";
            reg = <0>;
            backlight = <&dsi_backlight>;
            enable-gpios = <&gpio1c 1 GPIO_ACTIVE_HIGH>;

            ports {
                port {
                    panel_in: endpoint {
                        remote-endpoint = <&dsi_out>;
                    };
                };
            };
        };

        ports {
            #address-cells = <1>;
            #size-cells = <0>;

            port@0 {
                reg = <0>;
                display_encoder_in: endpoint {
                    remote-endpoint = <&crtc_out>;
                };
            };

            port@1 {
                reg = <1>;
                dsi_out: endpoint {
                    remote-endpoint = <&panel_in>;
                };
            };
        };
    };

...
```
