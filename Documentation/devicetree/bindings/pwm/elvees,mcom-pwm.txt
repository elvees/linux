## Documentation/devicetree/bindings/pwm/elvees,mcom-pwm.txt
```
ELVEES MCom-02 PWM controller

Required properties:
- compatible: should be "elvees,mcom-pwm".
- reg: physical base address and length of the controller's registers
- #pwm-cells: Should be 2. See pwm.txt in this directory for a
  description of the cells format.
- clocks: phandle to the PWM source clocks

Example:

	pwm: pwm@0x38090000 {
		compatible = "elvees,mcom-pwm";
		reg = <0x38090000 0x1000>;
		#pwm-cells = <2>;
		clocks = <&pwm_pclk>;
	};
```

## Documentation/devicetree/bindings/pwm/elvees,mcom-pwm.yaml
```yaml
# SPDX-License-Identifier: GPL-2.0-only OR BSD-2-Clause
%YAML 1.2
---
$id: http://devicetree.org/schemas/pwm/elvees,mcom-pwm.yaml#
$schema: http://devicetree.org/meta-schemas/core.yaml#

title: ELVEES MCom-03 PWM controller

maintainers:
  - Ilya Popov <ipopov@elvees.com>

description: |+
  Bindings for the ELVEES MCom-03 PWM controller.

  These bindings can be used on MCom-03 SoC.

  ELVEES MCom-03 PWM controller supports 4 channels and only one output for
  each channel.


properties:
  compatible:
    enum:
      - elvees,mcom-pwm

  "#pwm-cells":
    const: 2

  reg:
    maxItems: 1

  clocks:
    maxItems: 1

  elvees,output-channel:
    description: |+
      Array defines which output port to use for PWM channels.
      Value 0: OUTA; Value 1: OUTB
    $ref: /schemas/types.yaml#/definitions/uint32-array
    minItems: 4
    maxItems: 4
    items:
      minimum: 0
      maximum: 1

  elvees,state-on-disable:
    description: |+
      Array defines action on output port when pwm channel gets disabled.
      Value 0: no action;
      Value 1: set output to 0;
      Value 2: set output to 1;
      Value 3: toggle output.
    $ref: /schemas/types.yaml#/definitions/uint32-array
    minItems: 4
    maxItems: 4
    items:
      minimum: 0
      maximum: 3

required:
  - compatible
  - reg
  - '#pwm-cells'
  - clocks


additionalProperties: false

examples:
  - |
    pwm: pwm@0x1770000 {
      compatible = "elvees,mcom-pwm";
      reg = <0 0x1770000 0 0x1000>;
      #pwm-cells = <2>;
      clocks = <&lsperiph1_ucg0 8>;
      elvees,output-channel = <1 0 0 0>;
      elvees,state-on-disable = <1 0 0 0>;
    };
```

## Documentation/devicetree/bindings/reset/elvees,mcom03-reset.yaml
```yaml
# SPDX-License-Identifier: GPL-2.0
%YAML 1.2
---
$id: http://devicetree.org/schemas/reset/elvees,mcom03-reset.yaml#
$schema: http://devicetree.org/meta-schemas/core.yaml#

title: ELVEES MCom-03 reset controller

maintainers:
  - Oleg Ivanov <oaivanov@elvees.com>

description: |
  This document describes the MCom-03 reset controller.

  Please also refer to reset.txt in this directory for common reset
  controller binding usage.

properties:
  compatible:
    const: elvees,mcom03-reset

  reg:
    description: |
      Register offset and size in Universal Register Block (URB)
    maxItems: 1

  elvees,subsystem:
    description: Subsystem enum
    $ref: /schemas/types.yaml#/definitions/uint32

  "#reset-cells":
    const: 1

required:
  - compatible
  - reg
  - elvees,subsystem
  - "#reset-cells"

additionalProperties: false

examples:
  - |
    / {
      #include <dt-bindings/interrupt-controller/arm-gic.h>
      #include <dt-bindings/soc/elvees,mcom03.h>

      compatible = "elvees,mcom03";
      model = "elvees,mcom03";
      #address-cells = <2>;
      #size-cells = <2>;
      interrupt-parent = <&gic>;

      hsperiph-bus {
        compatible = "simple-bus";
        #address-cells = <2>;
        #size-cells = <2>;
        ranges;

        hsperiph_urb: urb@10400000 {
            compatible = "elvees,mcom03-urb", "syscon", "simple-mfd";
            #address-cells = <1>;
            #size-cells = <1>;
            reg = <0 0x10400000 0 0x200>;

            hsperiph_reset: reset-controller@8 {
                compatible = "elvees,mcom03-reset";
                reg = <0x8 0x4>;
                elvees,subsystem = <MCOM03_SUBSYSTEM_HSPERIPH>;
                #reset-cells = <1>;
            };
        };

        emac0: ethernet@10200000 {
            compatible = "arasan,gemac";
            reg = <0 0x10200000 0 0x1000>;
            interrupts = <GIC_SPI 39 IRQ_TYPE_LEVEL_HIGH>;
            resets = <&hsperiph_reset HSPERIPH_RST_EMAC0>;
            status = "disabled";
        };
      };
    };
```

## Documentation/devicetree/bindings/reset/mcom03-hsperiph-reset.txt
```
MCom-03 HSPERIPH reset controller
=================================

Required properties:
- compatible : "elvees,mcom03-hsperiph-reset"
- reg : register offset and size in HSPERIPH Universal Register Block (URB)
- urb : phandle to HSPERIPH URB node
- #reset-cells: 1

Please also refer to reset.txt in this directory for common reset
controller binding usage.

Example:
	hsperiph@0 {
		compatible = "simple-bus";
		#address-cells = <1>;
		#size-cells = <1>;
		ranges;

		hsurb: urb@10400000 {
			compatible = "elvees,mcom03-urb", "syscon";
			reg = <0x10400000 0x200>;
		};

		hsreset: reset-controller@8 {
			compatible = "elvees,mcom03-hsperiph-reset";
			reg = <0x8 0x4>;
			urb = <&hsurb>;
			#reset-cells = <1>;
		};
	};
```

## Documentation/devicetree/bindings/sound/elvees,simple-audio-selector.yaml
```yaml
# SPDX-License-Identifier: (GPL-2.0+ OR BSD-2-Clause)
%YAML 1.2
---
$id: http://devicetree.org/schemas/sound/elvees,simple-audio-selector.yaml#
$schema: http://devicetree.org/meta-schemas/core.yaml#

title: Simple Audio Selector

maintainers:
  - Ilya Popov <ipopov@elvees.com>

description: |
  Simple audio selector is used to control on-board bidirectional hardware mux
  controlled via GPIO. This selector is used to choose audio slave from
  multiple slaves connected to single master.

properties:
  compatible:
    const: simple-audio-selector

  select-gpios:
    description: |
      GPIO used to select the line.

  # Please read name-prefix.txt for details
  sound-name-prefix: true

required:
  - compatible
  - select-gpios

additionalProperties: false

examples:
  - |
    #include <dt-bindings/gpio/gpio.h>
    selector {
        compatible = "simple-audio-selector";
        select-gpios = <&gpio 3 GPIO_ACTIVE_HIGH>;
    };
```

## Documentation/devicetree/bindings/sound/elvees,trustphone-wm8998.yaml
```yaml
# SPDX-License-Identifier: GPL-2.0+
%YAML 1.2
---
$id: http://devicetree.org/schemas/sound/elvees,trustphone-wm8998.yaml#
$schema: http://devicetree.org/meta-schemas/core.yaml#

title: ELVEES Trustphone WM8998 soundcard

properties:
  compatible:
    enum:
      - elvees,trustphone-wm8998

  model:
    $ref: /schemas/types.yaml#/definitions/string
    description: The user-visible name of this soundcard.

  codec:
    type: object
    properties:
      sound-dai:
        $ref: /schemas/types.yaml#/definitions/phandle-array
        description: Phandle to the WM8998 codec

  elvees,audio-routing:
    $ref: /schemas/types.yaml#/definitions/non-unique-string-array
    description: |
      List of the connections between audio components. Each entry
      is a pair of strings, the first being the connection's sink,
      the second being the connection's source. Valid names for
      sources and sinks are the WM8998's pins (as documented in its
      binding), and modem pins: "Modem In", "Modem Out", "Modem TX",
      "Modem RX".

required:
  - compatible
  - model
  - codec
  - elvees,audio-routing

additionalProperties: false

examples:
  - |
    sound {
        compatible = "elvees,trustphone-wm8998";

        model = "Trustphone WM8998";

        elvees,audio-routing =
            "Modem Out", "Modem TX",
            "Modem RX", "Modem In",
            "AIF2 Capture", "Modem Out",
            "Modem RX", "AIF2 Playback",
            "IN2B", "MICBIAS1";

        codec {
            sound-dai = <&wm8998>;
        };
    };
```

## Documentation/devicetree/bindings/spi/silvaco-qspi.yaml
```yaml
# SPDX-License-Identifier: GPL-2.0+
%YAML 1.2
---
$id: http://devicetree.org/schemas/spi/silvaco-qspi.yaml#
$schema: http://devicetree.org/meta-schemas/core.yaml#

title: Silvaco QSPI controller

maintainers:
  - Omar Al-Wadi <oalwadi@elvees.com>

properties:
  compatible:
    oneOf:
      - items:
          - enum:
              - elvees,mcom03-hsperiph-qspi   # MCom-03 HSPERIPH URB support
              - elvees,mcom03-service-qspi    # MCom-03 SERVICE URB support
          - const: silvaco,axi-qspi

      - items:
          - const: silvaco,axi-qspi           # generic Silvaco QSPI controller

  reg:
    maxItems: 1

  '#address-cells':
    const: 1

  '#size-cells':
    const: 0

  clock-names:
    items:
      - const: clk_axi
      - const: clk_ext

  clocks:
    items:
      - description: Controller operating clock
      - description: Interface operating clock

  num-cs:
    minimum: 1
    maximum: 8

  elvees,urb:
    $ref: /schemas/types.yaml#/definitions/phandle
    description:
      A phandle to the syscon node describing URB registers.

  silvaco,qspi-mode:
    description: 0 - normal mode; 1 - XIP mode
    $ref: /schemas/types.yaml#/definitions/uint32
    enum:
      - 0
      - 1
    default: 0

# Slave schema can be found in file spi-controller.yaml in the same directory

additionalProperties: false

required:
  - compatible
  - '#address-cells'
  - '#size-cells'
  - reg
  - clocks
  - clock-names

examples:
  - |
    #include <dt-bindings/clock/mcom03-clock.h>

    qspi0: spi@1ff00000 {
      status = "disabled";
      compatible = "elvees,mcom03-hsperiph-qspi", "silvaco,axi-qspi";
      #address-cells = <1>;
      #size-cells = <0>;
      silvaco,qspi-mode = <0>;
      reg = <0x1ff00000 0x10000>;
      clock-names = "clk_axi", "clk_ext";
      clocks = <&service_ucg1 CLK_SERVICE_UCG0_QSPI0>,
              <&service_ucg1 CLK_SERVICE_UCG0_QSPI0_EXT>;
      num-cs = <4>;
    };
```

## Documentation/devicetree/bindings/usb/elvees,mcom03-dwc3.yaml
```yaml
# SPDX-License-Identifier: GPL-2.0
%YAML 1.2
---
$id: http://devicetree.org/schemas/usb/elvees,mcom03-dwc3.yaml#
$schema: http://devicetree.org/meta-schemas/core.yaml#

title: ELVEES MCom-03 USB Controller

description:
  To function correctly requires "snps,dis_u2_susphy_quirk" property in child
  DWC3 node.

properties:
  compatible:
    const: elvees,mcom03-dwc3

  "#address-cells":
    enum: [ 1, 2 ]

  "#size-cells":
    enum: [ 1, 2 ]

  ranges: true

  clocks:
    description:
      A list of phandle and clock-specifier pairs for the clocks
      listed in clock-names.
    items:
      - description: system clock
      - description: ref clock
      - description: suspend clock, used for usb wakeup logic

  clock-names:
    items:
      - const: sys
      - const: ref
      - const: suspend

  elvees,urb:
    description:
      A phandle to the syscon node describing URB registers.
    $ref: /schemas/types.yaml#/definitions/phandle

  elvees,ctrl-id:
    description:
      ID of the controller. It's used to calculate offsets of registers in URB.
    enum: [ 0, 1 ]

  resets:
    minItems: 1

# Required child node:

patternProperties:
  "^usb@[0-9a-f]+$":
    $ref: snps,dwc3.yaml#

required:
  - compatible
  - "#address-cells"
  - "#size-cells"
  - ranges
  - clocks
  - clock-names
  - elvees,ctrl-id
  - elvees,urb
  - resets

additionalProperties: false

examples:
  - |
    #include <dt-bindings/soc/elvees,mcom03.h>

    usb0: usb@10000000 {
        #address-cells = <2>;
        #size-cells = <2>;
        ranges;
        compatible = "elvees,mcom03-dwc3";
        clock-names = "sys", "ref", "suspend";
        clocks = <&usb_sys_clk>, <&usb_ref_clk>, <&usb_suspend_clk>;
        resets = <&hsperiph_reset HSPERIPH_RST_USB0>;
        elvees,urb = <&hsperiph_urb>;
        elvees,ctrl-id = <0>;

        dwc3@10000000 {
            compatible = "snps,dwc3";
            reg = <0 0x10000000 0 0x100000>;
            interrupts = <GIC_SPI 9 IRQ_TYPE_LEVEL_HIGH>;
            snps,dis_u2_susphy_quirk;
        };
    };
```

## Documentation/devicetree/bindings/watchdog/elvees,mcom03-wdt.yaml
```yaml
# SPDX-License-Identifier: (GPL-2.0-only OR BSD-2-Clause)
%YAML 1.2
---
$id: http://devicetree.org/schemas/watchdog/elvees,mcom03-wdt.yaml#
$schema: http://devicetree.org/meta-schemas/core.yaml#

title: MCom-03 WDT SiP

maintainers:
  - Mikhail Konovalov <mkonovalov@elvees.com>

description: |
  This document describes the MCom-03 WDT driver with Arm SiP calls.

  The Linux as launched in NS world is not able to read or write to registers
  located in secure or trusted world. MCom-03 WDT SiP driver implements procedure
  to communicate with secure world to setup WDT registers.

  Specifications about Arm SiP can be found at:
  https://trustedfirmware-a.readthedocs.io/en/latest/components/arm-sip-service.html

properties:
  compatible:
    enum:
      - elvees,mcom03-wdt

required:
  - compatible

additionalProperties: false

examples:
  - |
    wdt0: watchdog {
        compatible = "elvees,mcom03-wdt";
    };
...
```
